#include<Wire.h>
#include<Adafruit_GFX.h>
#include<Adafruit_SSD1306.h>
#include<DHT.h>
#define RESET LED_BUILTIN
//#define DHTPIN 14
//#define DHTTYPE DHT11

#include <ESP8266WiFi.h>
#define DHTPIN 14
#define DHTTYPE DHT11
const char* ssid     = "Zeeum12";
const char* password = "ziyad12345";
const char* host = "nodemcu.ziyadahmed.me"; 
DHT dht(DHTPIN, DHTTYPE);

//newcode
#include <ArduinoJson.h>
int count = 0;
String url2;

Adafruit_SSD1306 oled(RESET);
//DHT dht(DHTPIN, DHTTYPE);
int te, hu, tt, hh;
const unsigned char myBitmap [] PROGMEM = {
    0xff, 0xff, 0xff, 0xff, 0xff, 0xff, 0xff, 0xff, 0xff, 0xff, 0xff, 0xff, 0xff, 0xff, 0xff, 0xff, 
  0xff, 0xff, 0xff, 0xff, 0xff, 0xff, 0xf7, 0xff, 0xff, 0xff, 0xff, 0xff, 0xff, 0xff, 0xff, 0xff, 
  0xff, 0xff, 0xff, 0xff, 0xff, 0xff, 0xf8, 0xff, 0xff, 0xff, 0x7f, 0xff, 0xff, 0xff, 0xff, 0xff, 
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  0xff, 0xff, 0xff, 0xff, 0xff, 0xff, 0xff, 0xff, 0xff, 0xff, 0xff, 0xff, 0xff, 0xff, 0xff, 0xff
};
void setup()
{
//  Serial.begin(9600);
  delay(100);
  Serial.begin(115200);
  delay(100);
  dht.begin();
  Serial.println();
  Serial.println();
  Serial.print("Connecting to ");
  Serial.println(ssid);
  
  WiFi.begin(ssid, password); 
  while (WiFi.status() != WL_CONNECTED) {
    delay(500);
    Serial.print(".");
  }
  Serial.println("");
  Serial.println("WiFi connected");  
  Serial.println("IP address: ");
  Serial.println(WiFi.localIP());
  Serial.print("Netmask: ");
  Serial.println(WiFi.subnetMask());
  Serial.print("Gateway: ");
  Serial.println(WiFi.gatewayIP());
  delay(100);
  oled.begin(SSD1306_SWITCHCAPVCC, 0x3C);
  oled.clearDisplay();
  oled.clearDisplay();
  oled.drawBitmap(0, 0, myBitmap, 128, 64, WHITE);
  oled.display();
  delay(2000);
//  dht.begin();
//  delay(1000);
//newcode
  pinMode(12, OUTPUT);
  pinMode(13, OUTPUT);
  digitalWrite(12, 0);
  digitalWrite(13, 0);

}
void loop()
{
  float h = dht.readHumidity();
  // Read temperature as Celsius (the default)
  float t = dht.readTemperature();
  if (isnan(h) || isnan(t)) {
    Serial.println("Failed to read from DHT sensor!");
    return;
  }

  Serial.print("connecting to ");
  Serial.println(host);

  WiFiClient client;
  const int httpPort = 80;
  if (!client.connect(host, httpPort)) {
    Serial.println("connection failed");
    return;
  }
  
  String url = "/api/weather/insert.php?temp=" + String(t) + "&hum="+ String(h);
  Serial.print("Requesting URL: ");
  Serial.println(url);
  
  client.print(String("GET ") + url + " HTTP/1.1\r\n" +
               "Host: " + host + "\r\n" + 
               "Connection: close\r\n\r\n");
  delay(500);
  
  while(client.available()){
    String line = client.readStringUntil('\r');
    Serial.print(line);
  }
  
  Serial.println();
  Serial.println("closing connection");
  delay(3000);
  tt = dht.readTemperature();
  hh = dht.readHumidity();
  if (isnan(tt) || tt > 50)
  {
    te = te;
  }
  else
  {
    te = tt;
  }
  if (isnan(hh) || hh > 100)
  {
    hu = hu;
  }
  else
  {
    hu = hh;
  }
  oled.clearDisplay();
  oled.setTextSize(1);
  oled.setTextColor(WHITE);
  oled.drawRect(0, 0, 127, 63, WHITE);
  oled.setCursor(29, 5);
  oled.print("TEMPERATURE");
  oled.setTextSize(3);
  oled.setCursor(46, 20);
  oled.print(te);
  oled.setTextSize(1);
  oled.setCursor(37, 50);
  oled.print("DEGREES(C)");
  oled.display();
  delay(2000);
  oled.clearDisplay();
  oled.setTextSize(1);
  oled.setTextColor(WHITE);
  oled.drawRect(0, 0, 127, 63, WHITE);
  oled.setCursor(38, 5);
  oled.print("HUMIDITY");
  oled.setTextSize(3);
  oled.setCursor(46, 20);
  oled.print(hu);
  oled.setTextSize(1);
  oled.setCursor(54, 50);
  oled.print("(%)");
  oled.display();
  delay(2000);

  //newcode
  if (count == 0){
    url2 = "/api/led/read_all.php?id=1";
    count = count + 1;
    Serial.println("Here1");
  }
  else if (count == 1){
    url2 = "/api/led/read_all.php?id=2";
    count = count + 1;
    Serial.println("Here2");
  }
  Serial.print("Requesting URL: ");
  Serial.println(url2);
  client.print(String("GET ") + url2 + " HTTP/1.1\r\n" +
               "Host: " + host + "\r\n" + 
               "Connection: close\r\n\r\n");
  delay(500);
  String section="header";
  while(client.available()){
    String line = client.readStringUntil('\r');
    //Serial.print(line);
    // we’ll parse the HTML body here
    if (section=="header") { // headers..
     
      if (line=="\n") { // skips the empty space at the beginning 
        section="json";
      }
    }
   else if (section=="json") {  // print the good stuff
      section="ignore";
      String result = line.substring(1);

      // Parse JSON
      int size = result.length() + 1;
      char json[size];
      result.toCharArray(json, size);
      StaticJsonBuffer<200> jsonBuffer;
      JsonObject& json_parsed = jsonBuffer.parseObject(json);
      if (!json_parsed.success())
      {
        Serial.println("parseObject() failed");
        return;
      }
      String led = json_parsed["led"][0]["status"];

      if(count == 1){
        if(led == "on"){
          digitalWrite(5, 1);
          delay(100);
          Serial.println("1 is On..!");
        }
        else if(led == "off"){
          digitalWrite(5, 0);
          delay(100);
          Serial.println("1 is Off..!");
        }
      }
      else if(count == 2){
        if(led == "on"){
          digitalWrite(4, 1);
          Serial.println("2 is On..!");
        }
        else if(led == "off"){
          digitalWrite(4, 0);
          Serial.println("2 is Off..!");
        }
        count = 0;
      }

      if (count == 2)
        count = 0;
      

    }
  }
  Serial.println();
  Serial.println("closing connection");
  delay(3000);
   
}
